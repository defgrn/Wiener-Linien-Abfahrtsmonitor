#include <esp_now.h>
#include <WiFi.h>
#include <Wire.h>
#include <Adafruit_GFX.h>
#include <Adafruit_ST7789.h> 
#include <SPI.h>
#include <esp_wifi.h>

#define TFT_CS   15
#define TFT_RST   4 
#define TFT_DC    2
Adafruit_ST7789 tft = Adafruit_ST7789(TFT_CS, TFT_DC, TFT_RST);

typedef struct struct_message {
    char ipwebserver[16];
    char station[32];
    char linie[10];
    char richtung[32];
    int minuten;
} __attribute__((packed)) struct_message;
struct_message empfangeneDaten;

RTC_DATA_ATTR struct_message meineDaten; 
RTC_DATA_ATTR int bootzaehlen = 0;

RTC_DATA_ATTR struct_message meineDaten; 
RTC_DATA_ATTR int bootzaehlen = 0;  
RTC_DATA_ATTR char aktuelleRblChar[8] = "1252"; // neustift am walde 35a richtung spittelau
const unsigned long ZYKLUS_DAUER_S = 60;
const unsigned long WAKEUP_BUFFER_S = 2;
bool bekommen = false;
unsigned long splashStart = 0;
bool splashDone = false;

unsigned long anzeigeStartMillis = 0;
bool ersteDatenEmpfangen = false;

//splash screen
const unsigned char booat [] PROGMEM = {
  0x00, 0x00, 0x00, 0x00, 0x00, 0x00, 0x00, 0x00, 0x00, 0x00, 0x00, 0x00, 0x00, 0x00, 0x00, 0x00, 
	0x00, 0x00, 0x00, 0x00, 0x00, 0x00, 0x00, 0x00, 0x00, 0x00, 0x00, 0x00, 0x00, 0x00, 0x00, 0x00, 
	0x00, 0x00, 0x00, 0x00, 0x00, 0x00, 0x00, 0x00, 0x00, 0x00, 0x00, 0x00, 0x00, 0x00, 0x00, 0x00, 
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	0x00, 0x00, 0x00, 0x00, 0x00, 0x00, 0x00, 0x00, 0x00, 0x00, 0x00, 0x00, 0x00, 0x00, 0x00, 0x00
};

String fixUmlaute(String text) {
  text.replace("ä", "\x84");
  text.replace("ö", "\x94");
  text.replace("ü", "\x81");
  text.replace("Ä", "\x8E");
  text.replace("Ö", "\x99");
  text.replace("Ü", "\x9A");
  text.replace("ß", "ss");
  return text;
}



void abfahrten() {
  tft.fillScreen(ST77XX_BLACK);
  tft.setTextColor(ST77XX_WHITE);
  
  tft.setTextSize(2);
  tft.setCursor(10, 15);
  tft.println(fixUmlaute(empfangeneDaten.station));
  tft.drawFastHLine(0, 45, 240, ST77XX_WHITE); 

  tft.setCursor(10, 65);
  tft.setTextSize(4);
  tft.setTextColor(ST77XX_RED);
  tft.print(empfangeneDaten.linie); 

  tft.setTextColor(ST77XX_WHITE);
  tft.setTextSize(2);
  tft.setCursor(10, 115);
  
  String richtung = empfangeneDaten.richtung;
  if (richtung.length() > 15) {
    tft.println(fixUmlaute(richtung.substring(0, 14)));
    tft.setCursor(10, 140);
    tft.println(fixUmlaute(richtung.substring(14)));
  } else {
    tft.println(fixUmlaute(richtung));
  }

  tft.drawFastHLine(0, 175, 240, ST77XX_WHITE);

  tft.setCursor(10, 190);
  tft.setTextSize(6);
  tft.setTextColor(ST77XX_RED);
  if(empfangeneDaten.minuten == 0) {
    tft.print("*");
  } else {
    tft.print(empfangeneDaten.minuten);
  }
  
  tft.setTextSize(2);
  tft.setTextColor(ST77XX_WHITE);
  tft.print(" min");
}

void OnDataRecv(const esp_now_recv_info_t * info, const uint8_t *incomingData, int len) {
  int size = sizeof(empfangeneDaten);
  if (len < size) size = len;
  memcpy(&empfangeneDaten, incomingData, size);

  if (!ersteDatenEmpfangen) {
      anzeigeStartMillis = millis();
      ersteDatenEmpfangen = true;
  }

  Serial.print("Minuten empfangen: ");
  Serial.println(empfangeneDaten.minuten);
  if (millis() - anzeigeStartMillis >= 18000) {
      abfahrten();
  }
}

void setup() {
  Serial.begin(115200);
  WiFi.mode(WIFI_STA);
  esp_wifi_set_promiscuous(true);
  esp_wifi_set_channel(6, WIFI_SECOND_CHAN_NONE);
  esp_wifi_set_promiscuous(false);
  Serial.print("Kanal Empfängers: ");
  Serial.println(WiFi.channel());
  pinMode(DAC_PIN, OUTPUT);

  tft.init(240, 240);           
  tft.setRotation(3);
  tft.fillScreen(ST77XX_BLACK);
  tft.drawBitmap(40, 80, booat, 160, 80, ST77XX_WHITE);
  splashStart = millis();

  if (esp_now_init() != ESP_OK) {
    Serial.println("Fehler Initialisieren Esp Now");
    return;
  } 
  esp_now_register_recv_cb(OnDataRecv);
}

void loop() {
  unsigned long currentMillis = millis();
  unsigned long passed = currentMillis - splashStart;

  // Splash + Datenverbindung (0 bis 3 bis [wlan connect zeit] sek)
  if (!splashDone) {
    if (passed < 3000) {
      return;
    } else {
      splashDone = true;
      tft.fillScreen(ST77XX_BLACK);
      tft.setTextSize(2);
      tft.setTextColor(ST77XX_WHITE);
      tft.setCursor(20, 110);
      tft.println("Warte auf Daten...");
    }
  }

  // Webserver IP anzeigen ([wlan connect zeit] bis 18 sek)
  if (ersteDatenEmpfangen && (currentMillis - anzeigeStartMillis < 18000)) {
    static int lastSecond = -1;
    int currentSecond = (18000 - (currentMillis - anzeigeStartMillis)) / 1000;
    
    if (currentSecond != lastSecond) {
      lastSecond = currentSecond;
      tft.fillScreen(ST77XX_BLACK);
      tft.setTextColor(ST77XX_WHITE);
      
      tft.setTextSize(2);
      tft.setCursor(10, 30);
      tft.println("Webserver IP:");
      tft.setTextSize(3);
      tft.setTextColor(ST77XX_RED);
      tft.setCursor(10, 80);
      tft.println(empfangeneDaten.ipwebserver);
      
      tft.setTextSize(2);
      tft.setTextColor(ST77XX_WHITE);
      tft.setCursor(10, 180);
      tft.print("Startet in: ");
      tft.print(currentSecond);
      tft.println("s");
    }
  }

  // Daten nach 18 sek
  static bool uevergangErledigt = false;
  if (ersteDatenEmpfangen && !uevergangErledigt && (currentMillis - anzeigeStartMillis >= 18000)) {
    abfahrten(); 
    uevergangErledigt = true;
  }
}